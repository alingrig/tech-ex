## bootable-linux-task1/conf/bblayers.conf
```bitbake
BBLAYERS ?= " \
  /home/alin/UbuntuInterview/bootable-linux-test/bitbake-builds/poky-master/layers/openembedded-core/meta \
  /home/alin/UbuntuInterview/bootable-linux-test/bitbake-builds/poky-master/layers/meta-yocto/meta-yocto-bsp \
  /home/alin/UbuntuInterview/bootable-linux-test/bitbake-builds/poky-master/layers/meta-yocto/meta-poky \
  /home/alin/UbuntuInterview/bootable-linux-test/bitbake-builds/poky-master/layers/meta-yocto/meta-custom \
  "
```

## bootable-linux-task1/conf/local.conf
```bitbake
#
# This file is intended for local configuration tweaks.
#
# If you would like to publish and share changes made to this file,
# it is recommended to put them into a distro config, or to create
# layer fragments from changes made here.
#
PREFERRED_PROVIDER_virtual/kernel = "linux-kernel-custom"
PREFERRED_PROVIDER_linux-qemux86-64 = "linux-kernel-custom"
EXTRA_IMAGE_FEATURES += "empty-root-password serial-autologin-root"
IMAGE_INSTALL:append = " util-linux-agetty"

MACHINE = "qemux86-64"

IMAGE_FSTYPES += "wic"
WKS_FILE = "directdisk.wks"
```
